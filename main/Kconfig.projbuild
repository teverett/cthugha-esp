## main/Kconfig.projbuild
```kconfig
menu "Cthugha Configuration"

    menu "LCD Display"
        config CTHUGHA_LCD_BL_GPIO
            int "Backlight GPIO number"
            default 26

        config CTHUGHA_LCD_RST_GPIO
            int "LCD reset GPIO number"
            default 27
    endmenu

    menu "I2S Microphone"
        config CTHUGHA_I2S_NUM
            int "I2S peripheral number"
            default 0

        config CTHUGHA_I2S_MCLK_GPIO
            int "I2S master clock GPIO"
            default 13

        config CTHUGHA_I2S_BCK_GPIO
            int "I2S bit clock GPIO"
            default 12

        config CTHUGHA_I2S_WS_GPIO
            int "I2S word select GPIO"
            default 10

        config CTHUGHA_I2S_DIN_GPIO
            int "I2S data in GPIO"
            default 11

        config CTHUGHA_I2S_DOUT_GPIO
            int "I2S data out GPIO (codec DAC)"
            default 9

        config CTHUGHA_I2S_SAMPLE_RATE
            int "Sample rate (Hz)"
            default 16000
    endmenu

    menu "I2C Touch"
        config CTHUGHA_TOUCH_I2C_NUM
            int "I2C peripheral number"
            default 0

        config CTHUGHA_TOUCH_I2C_SDA_GPIO
            int "I2C SDA GPIO"
            default 7

        config CTHUGHA_TOUCH_I2C_SCL_GPIO
            int "I2C SCL GPIO"
            default 8

        config CTHUGHA_TOUCH_RST_GPIO
            int "Touch reset GPIO"
            default 5

        config CTHUGHA_TOUCH_INT_GPIO
            int "Touch interrupt GPIO"
            default 6
    endmenu

endmenu
```

## sdkconfig.defaults
```kconfig
CONFIG_IDF_TARGET="esp32p4"

# CPU - ESP32-P4 board max is 360 MHz
CONFIG_ESP_DEFAULT_CPU_FREQ_MHZ_360=y

# Compiler optimization
CONFIG_COMPILER_OPTIMIZATION_PERF=y

# PSRAM
CONFIG_SPIRAM=y
CONFIG_SPIRAM_SPEED_200M=y

# Required for MIPI-DSI features
CONFIG_IDF_EXPERIMENTAL_FEATURES=y

# FreeRTOS
CONFIG_FREERTOS_HZ=1000
CONFIG_FREERTOS_TIMER_TASK_STACK_DEPTH=4096

# Disable task watchdog (visualization is CPU-intensive)
CONFIG_ESP_TASK_WDT_EN=n

# Stack sizes
CONFIG_ESP_MAIN_TASK_STACK_SIZE=8192

# Partition table
CONFIG_PARTITION_TABLE_SINGLE_APP_LARGE=y
```
